## config/boards/nice_nano_v2.conf
```kconfig
# Configuraciones específicas del nice_nano_v2 para latencia mejorada (conservadora)

# Optimización básica del controlador Bluetooth
CONFIG_BT_CTLR_LOW_LAT=y

# Configuración de intervalos menos agresiva pero mejorada
CONFIG_BT_PERIPHERAL_PREF_MIN_INT=12
CONFIG_BT_PERIPHERAL_PREF_MAX_INT=24
CONFIG_BT_PERIPHERAL_PREF_LATENCY=0
CONFIG_BT_PERIPHERAL_PREF_TIMEOUT=300
```
